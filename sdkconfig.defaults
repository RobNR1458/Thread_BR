## sdkconfig.defaults
```kconfig
# ESP32-S3 is the host SoC on ESP-Thread-Border-Router board
CONFIG_IDF_TARGET="esp32s3"

#
# Serial flasher config
#
CONFIG_ESPTOOLPY_FLASHSIZE_8MB=y
# end of Serial flasher config

#
# Partition Table
#
CONFIG_PARTITION_TABLE_CUSTOM=y
CONFIG_PARTITION_TABLE_CUSTOM_FILENAME="partitions.csv"
CONFIG_PARTITION_TABLE_FILENAME="partitions.csv"
CONFIG_PARTITION_TABLE_OFFSET=0x8000
CONFIG_PARTITION_TABLE_MD5=y
# end of Partition Table

#
# Compiler options
#
CONFIG_COMPILER_OPTIMIZATION_SIZE=y

#
# Newlib
#
CONFIG_NEWLIB_ENABLE=y
CONFIG_NEWLIB_LIBRARY_LEVEL_NORMAL=y
CONFIG_NEWLIB_NANO_FORMAT=y

#
# mbedTLS
#
CONFIG_MBEDTLS_THREADING_ALT=n
CONFIG_SSL_USING_MBEDTLS=y
CONFIG_MBEDTLS_CMAC_C=y
CONFIG_MBEDTLS_SSL_PROTO_DTLS=y
CONFIG_MBEDTLS_KEY_EXCHANGE_ECJPAKE=y
CONFIG_MBEDTLS_ECJPAKE_C=y
CONFIG_MBEDTLS_THREADING_C=y
CONFIG_MBEDTLS_THREADING_PTHREAD=y

#
# OpenThread
#
CONFIG_OPENTHREAD_ENABLED=y
CONFIG_OPENTHREAD_BORDER_ROUTER=y
CONFIG_OPENTHREAD_CLI_OTA=y
CONFIG_OPENTHREAD_RCP_COMMAND=y
CONFIG_OPENTHREAD_RADIO_SPINEL_UART=y
# end of OpenThread

#
# OpenThread Border Router Example
#
CONFIG_AUTO_UPDATE_RCP=y
CONFIG_OPENTHREAD_BR_AUTO_START=y
# end of OpenThread Border Router Example

#
# Example Connection Configuration (WiFi)
#
CONFIG_EXAMPLE_CONNECT_WIFI=y
CONFIG_EXAMPLE_WIFI_SSID="Waffle2.4G"
CONFIG_EXAMPLE_WIFI_PASSWORD="Waffifis66*24*"
CONFIG_EXAMPLE_CONNECT_IPV4=y
CONFIG_EXAMPLE_CONNECT_IPV6=y
# end of Example Connection Configuration

#
# lwIP
#
CONFIG_LWIP_IPV6=y
CONFIG_LWIP_IPV6_FORWARD=y
CONFIG_LWIP_IPV6_NUM_ADDRESSES=12
CONFIG_LWIP_MULTICAST_PING=y
CONFIG_LWIP_NETIF_STATUS_CALLBACK=y
CONFIG_LWIP_HOOK_IP6_ROUTE_DEFAULT=y
CONFIG_LWIP_HOOK_ND6_GET_GW_DEFAULT=y
CONFIG_LWIP_HOOK_IP6_INPUT_CUSTOM=y
CONFIG_LWIP_IPV6_AUTOCONFIG=y
CONFIG_LWIP_HOOK_IP6_SELECT_SRC_ADDR_CUSTOM=y
CONFIG_LWIP_FORCE_ROUTER_FORWARDING=y
# end of lwIP

#
# mDNS
#
CONFIG_MDNS_MULTIPLE_INSTANCE=y
CONFIG_MDNS_MAX_SERVICES=200
# end of mDNS

#
# ESP System Settings
#
CONFIG_ESP_SYSTEM_EVENT_TASK_STACK_SIZE=3584
CONFIG_ESP_MAIN_TASK_STACK_SIZE=16384
# end of ESP System Settings

#
# ESP Border Router Board Kit
#
CONFIG_ESP_BR_BOARD_DEV_KIT=y
CONFIG_ESP_CONSOLE_USB_SERIAL_JTAG=y
# end of ESP Border Router Board Kit

#
# Ethernet (DISABLED - Using WiFi instead)
#
# CONFIG_EXAMPLE_USE_W5500 is not set
# end of Ethernet

#
# http server
#
CONFIG_HTTPD_MAX_REQ_HDR_LEN=1024

#
# pthread / threading
#
CONFIG_PTHREAD_TASK_STACK_SIZE_DEFAULT=8192

#
# Bootloader
#
CONFIG_BOOTLOADER_APP_ROLLBACK_ENABLE=y

#
# MQTT
#
CONFIG_MQTT_NETWORK_BUFFER_SIZE=2048
```
